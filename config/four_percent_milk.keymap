/*
 * Copyright (c) 2022 The ZMK Contributors
 *
 * SPDX-License-Identifier: MIT
 */

#include <behaviors.dtsi>
#include <dt-bindings/zmk/keys.h>
#include <dt-bindings/zmk/bt.h>
#include <dt-bindings/zmk/outputs.h>


#define DEFAULT 0
#define LOWER 1

/ {
    keymap {
        compatible = "zmk,keymap";
 
        default_layer {
            bindings = <  
                &kp X
                &kp Y
            >;
        };
/*        lower_layer {
            bindings = <
              &out OUT_TOG
              &trans
            >;
        };
*/
    };
};
