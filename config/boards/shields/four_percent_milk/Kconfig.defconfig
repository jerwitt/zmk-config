## config/boards/shields/four_percent_milk/Kconfig.defconfig
```kconfig
# Copyright (c) 2022 The ZMK Contributors
# SPDX-License-Identifier: MIT



config ZMK_BLE
  default y

config ZMK_USB
  default y

if SHIELD_FOUR_PERCENT_MILK

config ZMK_KEYBOARD_NAME
    default "4% Milk"

endif
```

## config/boards/shields/four_percent_milk/Kconfig.shield
```kconfig
# Copyright (c) 2022 The ZMK Contributors
# SPDX-License-Identifier: MIT

config SHIELD_FOUR_PERCENT_MILK
  def_bool $(shields_list_contains,four_percent_milk)
```
